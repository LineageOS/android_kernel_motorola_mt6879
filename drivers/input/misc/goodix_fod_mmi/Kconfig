## drivers/input/misc/goodix_fod_mmi/Kconfig
```kconfig
config INPUT_GOODIX_FOD_MMI
	tristate "MMI Goodix FOD sensor"
	default n
	help
	  Say Y here if you wish to include support for MMI Goodix FOD sensor.
	  If unsure, say N.
```

## drivers/misc/awinic/Kconfig
```kconfig
source "drivers/misc/awinic/sarsensor/Kconfig"
source "drivers/misc/awinic/aw86715/Kconfig"
```

## drivers/power/Kconfig
```kconfig
# SPDX-License-Identifier: GPL-2.0-only
source "drivers/power/reset/Kconfig"
source "drivers/power/supply/Kconfig"

config MMI_QC3P_TURBO_CHARGER
	bool "Enable MMI QC3P Turbo Charger"
	default n
	help
	  Say Y here if you have a MMI QC3P turbo charger compatible device connected.
	  If unsure, say N.

config MMI_QC3P_WT6670_DETECTED
	bool "Enable MMI QC3P WT6670 detection"
	default n
	help
	  Say Y here to enable MMI QC3P WT6670 detection.
	  If unsure, say N.

config MMI_QC3P_Z350_DETECTED
	bool "Enable MMI QC3P Z350 detection"
	default n
	help
	  Say Y here to enable MMI QC3P Z350 detection.
	  If unsure, say N.

config MMI_EXT_CHG_LED
	bool "Enable MMI external charger LED"
	default n
	help
	  Say Y here if you have a MMI external charger LED.
	  If unsure, say N.

source "drivers/power/nfg1000_fg_mmi/Kconfig"
source "drivers/power/mmi_gauge_class/Kconfig"
source "drivers/power/qpnp_adaptive_charge/Kconfig"
source "drivers/power/smart_battery/Kconfig"
source "drivers/power/bq25980_mmi/Kconfig"
```

## drivers/power/cps4038_mmi/Kconfig
```kconfig
config CPS4038_MMI
	tristate "CPS4038 MMI"
	default n
	help
	  Say Y here to build the CPS4038 MMI driver as a module.
	  If unsure, say N.
```

## drivers/power/mmi_gauge_class/Kconfig
```kconfig
config MMI_GAUGE_CLASS
	tristate "MMI GAUGE CLASS"
	default n
	help
	  Say Y here if you have a mmi gauge class compatible
	  device connected.

	  This driver can also be built as a module.  If so, the module
	  will be called mmi-gauge-class.
```

## drivers/power/nfg1000_fg_mmi/Kconfig
```kconfig
config  NFG1000_FG_MMI
	tristate "NFG1000 FG MMI"
	default n
	help
	  Say Y here if you have a nfg1000 fg mmi compatible
	  device connected.

	  This driver can also be built as a module.  If so, the module
	  will be called nfg1000-fg-mmi.
```

## drivers/power/smart_battery/Kconfig
```kconfig
config SMART_BATTERY
	tristate "SMART BATTERY"
	default n
	help
	  Say Y here if you have a qpnp adaptive charge compatible
	  device connected.

	  This driver can also be built as a module.  If so, the module
	  will be called smart_battery.
```
